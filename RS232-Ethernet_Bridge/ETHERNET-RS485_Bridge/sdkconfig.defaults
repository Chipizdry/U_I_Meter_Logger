## RS232-Ethernet_Bridge/ETHERNET-RS485_Bridge/sdkconfig.defaults
```kconfig
# Ethernet Configuration for WT32-ETH01
CONFIG_ETH_USE_ESP32_EMAC=y
CONFIG_ETH_PHY_INTERFACE_RMII=y

# External 50MHz clock on GPIO0
CONFIG_ETH_RMII_CLK_INPUT=y
CONFIG_ETH_RMII_CLK_OUTPUT=n
CONFIG_ETH_RMII_CLK_INPUT_GPIO=0
CONFIG_ETH_RMII_CLK_OUT_GPIO=17

# SMI Configuration
CONFIG_ETH_SMI_MDC_GPIO=23
CONFIG_ETH_SMI_MDIO_GPIO=18

# PHY Configuration
CONFIG_ETH_PHY_LAN87XX=y
CONFIG_ETH_PHY_ADDR=1
CONFIG_ETH_PHY_RST_GPIO=-1

# Task Priority
CONFIG_ETH_TASK_PRIORITY=15
CONFIG_ETH_TASK_STACK_SIZE=4096

# Increase timeouts
CONFIG_ETH_PHY_AUTONEGO_TIMEOUT_MS=5000
CONFIG_ETH_PHY_LINK_UP_TIMEOUT_MS=10000

# Disable WiFi
CONFIG_ESP32_WIFI_ENABLED=n

# LWIP
CONFIG_LWIP_MAX_SOCKETS=10

# FreeRTOS
CONFIG_FREERTOS_HZ=100
CONFIG_ESP_MAIN_TASK_STACK_SIZE=4096

# Logger
CONFIG_LOG_DEFAULT_LEVEL_INFO=y
```
